## package/gamestation/Config.in
```kconfig
menu "gamestation.linux"

menu "System"
  source "package/gamestation/core/gamestation-system/Config.in"
  source "package/gamestation/core/gamestation-configgen/Config.in"
  source "package/gamestation/core/gamestation-retrogame/Config.in"
  source "package/gamestation/core/gamestation-desktopapps/Config.in"
  source "package/gamestation/alllinuxfirmwares/Config.in"

  menu "Boot"
    source "package/gamestation/boot/gamestation-initramfs/Config.in"
    source "package/gamestation/boot/gamestation-x86_64_efi/Config.in"
    source "package/gamestation/boot/uboot-odroid-xu4/Config.in"
    source "package/gamestation/boot/uboot-odroid-c2/Config.in"
    source "package/gamestation/boot/rockpro64-blobs/Config.in"
  endmenu

  menu "Toolchain"
    source "package/gamestation/toolchain/toolchain-optional-linaro-aarch64/Config.in"
  endmenu

  menu "Fonts"
    source "package/gamestation/fonts/nanum-font/Config.in"
  endmenu

  menu "Arch"
    source "package/gamestation/arch/firmware-rockpro64/Config.in"
  endmenu

  menu "Gpu"
    source "package/gamestation/gpu/android-headers/Config.in"
    source "package/gamestation/gpu/gpu-aml/Config.in"
    source "package/gamestation/gpu/gpu-aml-t8xx/Config.in"
    source "package/gamestation/gpu/libhybris/Config.in"
    source "package/gamestation/gpu/mali-rk450/Config.in"
    source "package/gamestation/gpu/mali-450/Config.in"
    source "package/gamestation/gpu/mali-opengles-sdk/Config.in"
    source "package/gamestation/gpu/mali-t62x-fbdev/Config.in"
    source "package/gamestation/gpu/mali-t62x-wayland/Config.in"
    source "package/gamestation/gpu/opengl-meson-t82x/Config.in"
  endmenu

  menu "Device trees"
    source "package/gamestation/device-trees/device-trees-aml-s9xx/Config.in"
  endmenu
endmenu

menu "Emulationstation"
  source "package/gamestation/emulationstation/gamestation-emulationstation/Config.in"
  source "package/gamestation/emulationstation/gamestation-es-system/Config.in"
  source "package/gamestation/emulationstation/python-es-scraper/Config.in"
  source "package/gamestation/emulationstation/gamestation-themes/Config.in"
  source "package/gamestation/emulationstation/sselph-scraper/Config.in"
endmenu

menu "Controllers"
  source "package/gamestation/controllers/db9_gpio_rpi/Config.in"
  source "package/gamestation/controllers/gamecon_gpio_rpi/Config.in"
  source "package/gamestation/controllers/mk_arcade_joystick_rpi/Config.in"
  source "package/gamestation/controllers/qtsixa/Config.in"
  source "package/gamestation/controllers/qtsixa-shanwan/Config.in"
  source "package/gamestation/controllers/virtualgamepads/Config.in"
  source "package/gamestation/controllers/xarcade2jstick/Config.in"
  source "package/gamestation/controllers/xboxdrv/Config.in"
  source "package/gamestation/controllers/qt5gamepad/Config.in"
endmenu

menu "Emulators"
  menu "Retroarch"
    source "package/gamestation/emulators/retroarch/retroarch/Config.in"
    source "package/gamestation/emulators/retroarch/gamestation-shaders/Config.in"
    menu "cores"
    source "package/gamestation/emulators/retroarch/libretro/libretro-atari800/Config.in"
    source "package/gamestation/emulators/retroarch/libretro/libretro-pocketsnes/Config.in"
    source "package/gamestation/emulators/retroarch/libretro/libretro-catsfc/Config.in"
    source "package/gamestation/emulators/retroarch/libretro/libretro-beetle-vb/Config.in"
    source "package/gamestation/emulators/retroarch/libretro/libretro-snes9x/Config.in"
    source "package/gamestation/emulators/retroarch/libretro/libretro-snes9x-next/Config.in"
    source "package/gamestation/emulators/retroarch/libretro/libretro-desmume/Config.in"
    source "package/gamestation/emulators/retroarch/libretro/libretro-picodrive/Config.in"
    source "package/gamestation/emulators/retroarch/libretro/libretro-genesisplusgx/Config.in"
    source "package/gamestation/emulators/retroarch/libretro/libretro-gambatte/Config.in"
    source "package/gamestation/emulators/retroarch/libretro/libretro-stella/Config.in"
    source "package/gamestation/emulators/retroarch/libretro/libretro-pcsx/Config.in"
    source "package/gamestation/emulators/retroarch/libretro/libretro-beetle-psx/Config.in"
    source "package/gamestation/emulators/retroarch/libretro/libretro-beetle-saturn/Config.in"
    source "package/gamestation/emulators/retroarch/libretro/libretro-fceumm/Config.in"
    source "package/gamestation/emulators/retroarch/libretro/libretro-fceunext/Config.in"
    source "package/gamestation/emulators/retroarch/libretro/libretro-nestopia/Config.in"
    source "package/gamestation/emulators/retroarch/libretro/libretro-imame/Config.in"
    source "package/gamestation/emulators/retroarch/libretro/libretro-scummvm/Config.in"
    source "package/gamestation/emulators/retroarch/libretro/libretro-beetle-pce/Config.in"
    source "package/gamestation/emulators/retroarch/libretro/libretro-beetle-pcfx/Config.in"
    source "package/gamestation/emulators/retroarch/libretro/libretro-meteor/Config.in"
    source "package/gamestation/emulators/retroarch/libretro/libretro-virtualjaguar/Config.in"
    source "package/gamestation/emulators/retroarch/libretro/libretro-fmsx/Config.in"
    source "package/gamestation/emulators/retroarch/libretro/libretro-bluemsx/Config.in"
    source "package/gamestation/emulators/retroarch/libretro/libretro-gpsp/Config.in"
    source "package/gamestation/emulators/retroarch/libretro/libretro-4do/Config.in"
    source "package/gamestation/emulators/retroarch/libretro/libretro-fba/Config.in"
    source "package/gamestation/emulators/retroarch/libretro/libretro-gw/Config.in"
    source "package/gamestation/emulators/retroarch/libretro/libretro-prboom/Config.in"
    source "package/gamestation/emulators/retroarch/libretro/libretro-beetle-ngp/Config.in"
    source "package/gamestation/emulators/retroarch/libretro/libretro-vecx/Config.in"
    source "package/gamestation/emulators/retroarch/libretro/libretro-beetle-lynx/Config.in"
    source "package/gamestation/emulators/retroarch/libretro/libretro-lutro/Config.in"
    source "package/gamestation/emulators/retroarch/libretro/libretro-beetle-wswan/Config.in"
    source "package/gamestation/emulators/retroarch/libretro/libretro-uae/Config.in"
    source "package/gamestation/emulators/retroarch/libretro/libretro-parallel-n64/Config.in"
    source "package/gamestation/emulators/retroarch/libretro/libretro-beetle-supergrafx/Config.in"
    source "package/gamestation/emulators/retroarch/libretro/libretro-nxengine/Config.in"
    source "package/gamestation/emulators/retroarch/libretro/libretro-prosystem/Config.in"
    source "package/gamestation/emulators/retroarch/libretro/libretro-tgbdual/Config.in"
    source "package/gamestation/emulators/retroarch/libretro/libretro-mgba/Config.in"
    source "package/gamestation/emulators/retroarch/libretro/libretro-mame2003/Config.in"
    source "package/gamestation/emulators/retroarch/libretro/libretro-mame2003-plus/Config.in"
    source "package/gamestation/emulators/retroarch/libretro/libretro-mame2010/Config.in"
    source "package/gamestation/emulators/retroarch/libretro/libretro-fuse/Config.in"
    source "package/gamestation/emulators/retroarch/libretro/libretro-cap32/Config.in"
    source "package/gamestation/emulators/retroarch/libretro/libretro-81/Config.in"
    source "package/gamestation/emulators/retroarch/libretro/libretro-imageviewer/Config.in"
    source "package/gamestation/emulators/retroarch/libretro/libretro-o2em/Config.in"
    source "package/gamestation/emulators/retroarch/libretro/libretro-hatari/Config.in"
    source "package/gamestation/emulators/retroarch/libretro/libretro-quicknes/Config.in"
    source "package/gamestation/emulators/retroarch/libretro/libretro-redream/Config.in"
    source "package/gamestation/emulators/retroarch/libretro/libretro-yabause/Config.in"
    source "package/gamestation/emulators/retroarch/libretro/libretro-freeintv/Config.in"
    source "package/gamestation/emulators/retroarch/libretro/libretro-cheats/Config.in"
    source "package/gamestation/emulators/retroarch/libretro/libretro-mupen64plus/Config.in"
    source "package/gamestation/emulators/retroarch/libretro/libretro-reicast/Config.in"
    source "package/gamestation/emulators/retroarch/libretro/libretro-px68k/Config.in"
    source "package/gamestation/emulators/retroarch/libretro/libretro-dolphin/Config.in"
    source "package/gamestation/emulators/retroarch/libretro/libretro-ppsspp/Config.in"
    source "package/gamestation/emulators/retroarch/libretro/libretro-dosbox/Config.in"
    source "package/gamestation/emulators/retroarch/libretro/libretro-vice/Config.in"
    source "package/gamestation/emulators/retroarch/libretro/libretro-mame2016/Config.in"
    source "package/gamestation/emulators/retroarch/libretro/libretro-mame/Config.in"
    source "package/gamestation/emulators/retroarch/libretro/libretro-citra/Config.in"
    source "package/gamestation/emulators/retroarch/libretro/libretro-kronos/Config.in"
    endmenu
  endmenu

  source "package/gamestation/emulators/advancemame/Config.in"
  source "package/gamestation/emulators/amiberry/Config.in"
  source "package/gamestation/emulators/dolphin-emu/Config.in"
  source "package/gamestation/emulators/dosbox/Config.in"
  source "package/gamestation/emulators/fsuae/Config.in"
  source "package/gamestation/emulators/fsuae-capsimg-plugin/Config.in"
  source "package/gamestation/emulators/gpsp/Config.in"
  source "package/gamestation/emulators/linapple-pie/Config.in"
  source "package/gamestation/emulators/moonlight-embedded/Config.in"

  menu "mupen64plus"
    source "package/gamestation/emulators/mupen64plus/mupen64plus-core/Config.in"
    source "package/gamestation/emulators/mupen64plus/mupen64plus-uiconsole/Config.in"
    source "package/gamestation/emulators/mupen64plus/mupen64plus-gles2/Config.in"
    source "package/gamestation/emulators/mupen64plus/mupen64plus-gles2rice/Config.in"
    source "package/gamestation/emulators/mupen64plus/mupen64plus-video-glide64mk2/Config.in"
    source "package/gamestation/emulators/mupen64plus/mupen64plus-omx/Config.in"
    source "package/gamestation/emulators/mupen64plus/mupen64plus-input-sdl/Config.in"
    source "package/gamestation/emulators/mupen64plus/mupen64plus-audio-sdl/Config.in"
    source "package/gamestation/emulators/mupen64plus/mupen64plus-rsphle/Config.in"
    source "package/gamestation/emulators/mupen64plus/mupen64plus-rice/Config.in"
    source "package/gamestation/emulators/mupen64plus/mupen64plus-gliden64/Config.in"
  endmenu

  source "package/gamestation/emulators/pcsx2/Config.in"
  source "package/gamestation/emulators/pcsx2_avx2/Config.in"
  source "package/gamestation/emulators/pcsx2-x86/Config.in"
  source "package/gamestation/emulators/pifba/Config.in"
  source "package/gamestation/emulators/ppsspp/Config.in"
  source "package/gamestation/emulators/ppsspp15/Config.in"
  source "package/gamestation/emulators/reicast/Config.in"
  source "package/gamestation/emulators/scummvm/Config.in"
  source "package/gamestation/emulators/vice/Config.in"
  source "package/gamestation/emulators/citra/Config.in"
endmenu

menu "Kodi"
  source "package/gamestation/kodi/kodi-joystick/Config.in"
  source "package/gamestation/kodi/kodi-plugin-video-filmon/Config.in"
  source "package/gamestation/kodi/kodi-superrepo-all/Config.in"
  source "package/gamestation/kodi/kodi-superrepo-repositories/Config.in"
  source "package/gamestation/kodi/kodi-resource-language-de_de/Config.in"
  source "package/gamestation/kodi/kodi-resource-language-es_es/Config.in"
  source "package/gamestation/kodi/kodi-resource-language-eu_es/Config.in"
  source "package/gamestation/kodi/kodi-resource-language-fr_fr/Config.in"
  source "package/gamestation/kodi/kodi-resource-language-it_it/Config.in"
  source "package/gamestation/kodi/kodi-resource-language-pt_br/Config.in"
  source "package/gamestation/kodi/kodi-resource-language-sv_se/Config.in"
  source "package/gamestation/kodi/kodi-resource-language-tr_tr/Config.in"
  source "package/gamestation/kodi/kodi-resource-language-zh_cn/Config.in"
endmenu

menu "Utils"
  source "package/gamestation/utils/raspi2png/Config.in"
  source "package/gamestation/utils/megatools/Config.in"
  source "package/gamestation/utils/jstest2/Config.in"
  source "package/gamestation/utils/unclutter/Config.in"
  source "package/gamestation/utils/fluidsynth/Config.in"
  source "package/gamestation/utils/xosd/Config.in"
endmenu

menu "Libraries"
  source "package/gamestation/libraries/guichan/Config.in"
  source "package/gamestation/libraries/libcapsimage/Config.in"
  source "package/gamestation/libraries/libenet/Config.in"
  source "package/gamestation/libraries/openal-soft/Config.in"
  source "package/gamestation/libraries/python-autobreadcrumbs/Config.in"
  source "package/gamestation/libraries/python-rpigpio/Config.in"
  source "package/gamestation/libraries/sfml/Config.in"
  source "package/gamestation/libraries/wxwidgets/Config.in"
  source "package/gamestation/libraries/python-evdev/Config.in"
  source "package/gamestation/libraries/libglvnd/Config.in"
endmenu

endmenu
```

## package/gamestation/boot/gamestation-initramfs/Config.in
```kconfig
config BR2_PACKAGE_GAMESTATION_INITRAMFS
	bool "Gamestation initramfs"
	default n
	help
	  A simple initramfs based on busybox.

	  http://busybox.net/
```

## package/gamestation/boot/gamestation-x86_64_efi/Config.in
```kconfig
config BR2_PACKAGE_GAMESTATION_X86_64_EFI
    bool "gamestation-x86_64_efi"
    help
      EFI 64 bit precompiled

      https://github.com/gamestation-linux/gamestation-x86_64_efi
```

## package/gamestation/core/gamestation-configgen/Config.in
```kconfig
config BR2_PACKAGE_GAMESTATION_CONFIGGEN
        bool "gamestation configgen"
	select BR2_PACKAGE_PYTHON
	select BR2_PACKAGE_PYTHON_PYYAML
        help
          The configuration utility for gamestation
	  The purpose of the lib is to automatically configure emulators, using the environment variables available in Gamestation.
          The main program is emulatorlauncher.py, taking 13 parameters, that are the system and 4 controllers configurations.
```

## package/gamestation/core/gamestation-desktopapps/Config.in
```kconfig
config BR2_PACKAGE_GAMESTATION_DESKTOPAPPS
    bool "gamestation-desktopapps"
    depends on BR2_PACKAGE_XSERVER_XORG_SERVER
    depends on BR2_PACKAGE_PCMANFM # file manager
    help
      Gamestation desktop applications
```

## package/gamestation/core/gamestation-retrogame/Config.in
```kconfig
config BR2_PACKAGE_GAMESTATION_RETROGAME
    bool "gamestation-retrogame"
    help
      Gamestation-retrogame is optimized for Pi2 and manage a 2 player panel with an ESC key
```

## package/gamestation/emulationstation/gamestation-es-system/Config.in
```kconfig
config BR2_PACKAGE_GAMESTATION_ES_SYSTEM
        bool "gamestation-es-system"
        help
          Generates the es_system.cfg file and the roms folder
```

## package/gamestation/emulationstation/gamestation-themes/Config.in
```kconfig
config BR2_PACKAGE_GAMESTATION_THEMES
        bool "gamestation ES themes"
        help
          Emulationstation themes for gamestation.

	  https://github.com/gamestation-linux/gamestation-themes
```

## package/gamestation/emulators/retroarch/gamestation-shaders/Config.in
```kconfig
config BR2_PACKAGE_GAMESTATION_SHADERS
        bool "gamestation shaders"
	depends on BR2_PACKAGE_RETROARCH
        help
          Gamestation shaders for retroarch
```
